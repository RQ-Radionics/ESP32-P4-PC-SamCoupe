/*
 * sim_audio.c — Audio driver for Agon MOS (Olimex ESP32-P4-PC)
 *
 * Uses the direct ES8311 driver (es8311_local.c) instead of esp_codec_dev,
 * to get explicit control over the ADC power-down path.
 *
 * Root cause of the white-noise problem:
 *   esp_codec_dev calls es8311_start() unconditionally, which writes
 *   ADC_REG17=0xBF and ADC_REG15=0x40, activating the ADC analog path.
 *   With no microphone connected (floating AINL/AINR), the ADC sigma-delta
 *   modulator amplifies thermal noise and outputs a continuous LFSR-like
 *   white-noise stream on I2S RX — which is looped back to the speaker.
 *
 * Fix:
 *   After es8311_init() (which powers up both DAC and ADC), call
 *   es8311_adc_power_down() to set REG0E[5:4]=11 (power down ADC PGA +
 *   modulator) and zero REG15, REG17.  DAC remains fully active.
 *
 * I2S configuration:
 *   - TX-only channel (NULL rx) — I2S RX hardware is unused
 *   - I2S_SLOT_MODE_STEREO — ES8311 expects stereo LRCK framing; synth
 *     outputs the same mono sample to both L and R channels
 *   - Sample rate: 16384 Hz (Agon / BBC Micro canonical audio rate)
 *   - MCLK = 256 × 16384 = 4,194,304 Hz generated by I2S APLL
 *   - ES8311 clock config uses ratio (4096000/16000 = 256), which is
 *     identical in terms of divider ratios to our actual (4194304/16384).
 *     The ES8311 in slave mode follows the I2S master's LRCK regardless.
 */

#include <string.h>
#include "freertos/FreeRTOS.h"
#include "freertos/task.h"
#include "driver/gpio.h"
#include "driver/i2c_master.h"
#include "driver/i2s_std.h"
#include "esp_log.h"
#include "esp_err.h"
#include "esp_check.h"

#include "es8311_local.h"
#include "sim_audio.h"

static const char *TAG = "sim_audio";

/* I2S MCLK multiple — 256 × 44100 = 11,289,600 Hz */
#define MCLK_MULTIPLE  I2S_MCLK_MULTIPLE_256

static i2s_chan_handle_t  s_i2s_tx      = NULL;
static es8311_handle_t    s_es8311      = NULL;
static i2c_master_bus_handle_t s_i2c_bus = NULL;
static bool               s_bus_owned   = false;
static bool               s_initialized = false;

/* ------------------------------------------------------------------ */
/* I2S TX channel init                                                  */
/* ------------------------------------------------------------------ */
static esp_err_t audio_i2s_init(void)
{
    /* TX-only: pass NULL for rx — no I2S RX hardware needed.
     * DMA buffer: 4 descriptors × 882 frames = 3528 frames = ~80ms at 44100Hz.
     * SimCoupe generates 882 stereo frames per emulation frame (44100/50).
     * With audiosync=true, i2s_channel_write blocks when the ring is full,
     * acting as the master clock.  The buffer must hold at least 2 frames
     * (1764 frames) to absorb jitter; 4 frames gives comfortable headroom. */
    i2s_chan_config_t chan_cfg = I2S_CHANNEL_DEFAULT_CONFIG(
        CONFIG_SIM_AUDIO_I2S_NUM, I2S_ROLE_MASTER);
    chan_cfg.auto_clear    = true;
    chan_cfg.dma_desc_num  = 4;    /* 4 DMA descriptors */
    chan_cfg.dma_frame_num = 882;  /* one SAM frame per DMA descriptor */
    ESP_RETURN_ON_ERROR(
        i2s_new_channel(&chan_cfg, &s_i2s_tx, NULL),
        TAG, "i2s_new_channel");

    /* Stereo 16-bit I2S at 44100 Hz.
     * SimCoupe Sound.cpp generates native stereo (L+R interleaved int16_t).
     * ES8311 expects I2S_SLOT_MODE_STEREO LRCK framing.
     *
     * Clock source: I2S_CLK_SRC_DEFAULT (XTAL 40MHz on ESP32-P4 rev<3).
     * I2S_CLK_SRC_APLL causes the I2S to run at ~27562 Hz instead of 44100 Hz
     * because the APLL mclk_div=2 calculation in i2s_set_get_apll_freq() produces
     * an incorrect APLL frequency on this silicon (ratio 5/8 observed).
     * With I2S_CLK_SRC_DEFAULT the driver uses integer division from XTAL,
     * which gives a small frequency error (~0.1%) that the ES8311 tolerates. */
    i2s_std_config_t std_cfg = {
        .clk_cfg  = {
            .sample_rate_hz = CONFIG_SIM_AUDIO_SAMPLE_RATE,
            .clk_src        = I2S_CLK_SRC_DEFAULT,
            .mclk_multiple  = MCLK_MULTIPLE,
        },
        .slot_cfg = I2S_STD_PHILIP_SLOT_DEFAULT_CONFIG(
                        I2S_DATA_BIT_WIDTH_16BIT, I2S_SLOT_MODE_STEREO),
        .gpio_cfg = {
            .mclk = CONFIG_SIM_AUDIO_I2S_MCLK_GPIO,
            .bclk = CONFIG_SIM_AUDIO_I2S_BCLK_GPIO,
            .ws   = CONFIG_SIM_AUDIO_I2S_WS_GPIO,
            .dout = CONFIG_SIM_AUDIO_I2S_DOUT_GPIO,
            .din  = I2S_GPIO_UNUSED,
            .invert_flags = { false, false, false },
        },
    };
    ESP_RETURN_ON_ERROR(
        i2s_channel_init_std_mode(s_i2s_tx, &std_cfg), TAG, "i2s_init_std");

    /* Pre-load DMA TX buffers with silence before enabling.
     * Without this, uninitialized DMA memory is clocked to the ES8311 DAC
     * from the instant i2s_channel_enable() is called until the synth task
     * writes its first zero-filled buffer.  The pre-load also serves as the
     * "zero-period" that verifies the DMA ring is ready before audio starts. */
    {
        static const int16_t silence[512] = {0};
        size_t loaded = 0;
        do {
            i2s_channel_preload_data(s_i2s_tx, silence, sizeof(silence), &loaded);
        } while (loaded > 0);
    }
    ESP_RETURN_ON_ERROR(
        i2s_channel_enable(s_i2s_tx), TAG, "i2s_enable");

    return ESP_OK;
}

/* ------------------------------------------------------------------ */
/* ES8311 codec init                                                     */
/* ------------------------------------------------------------------ */
static esp_err_t audio_codec_init(i2c_master_bus_handle_t bus)
{
#if CONFIG_SIM_AUDIO_PA_GPIO >= 0
    /* Power amplifier enable (active HIGH) — drive HIGH before codec init
     * so there is no pop from PA powering on after audio is live. */
    gpio_config_t pa_cfg = {
        .pin_bit_mask = (1ULL << CONFIG_SIM_AUDIO_PA_GPIO),
        .mode         = GPIO_MODE_OUTPUT,
        .pull_up_en   = GPIO_PULLUP_DISABLE,
        .pull_down_en = GPIO_PULLDOWN_DISABLE,
        .intr_type    = GPIO_INTR_DISABLE,
    };
    gpio_config(&pa_cfg);
    gpio_set_level(CONFIG_SIM_AUDIO_PA_GPIO, 1);
    ESP_LOGI(TAG, "PA GPIO%d enabled (HIGH)", CONFIG_SIM_AUDIO_PA_GPIO);
#endif

    s_es8311 = es8311_create(bus, ES8311_ADDRESS_0);
    ESP_RETURN_ON_FALSE(s_es8311, ESP_ERR_NO_MEM, TAG, "es8311_create");

    /* Clock config: use MCLK pin.
     * SimCoupe uses 44100 Hz stereo. MCLK = 256 × 44100 = 11,289,600 Hz.
     * ES8311 slave mode follows I2S master LRCK; the coefficient table
     * lookup selects dividers based on mclk_frequency/sample_frequency ratio. */
    es8311_clock_config_t clk_cfg = {
        .mclk_inverted     = false,
        .sclk_inverted     = false,
        .mclk_from_mclk_pin = true,
        .mclk_frequency    = 11289600,  /* 256 × 44100 Hz */
        .sample_frequency  = 44100,
    };
    ESP_RETURN_ON_ERROR(
        es8311_init(s_es8311, &clk_cfg, ES8311_RESOLUTION_16, ES8311_RESOLUTION_16),
        TAG, "es8311_init");

    /* Power down ADC — no microphone on the Olimex ESP32-P4-PC board.
     * es8311_init() leaves the ADC modulator enabled (REG0E=0x02).
     * With floating AINL/AINR inputs the ADC produces white noise that
     * would appear in the I2S data stream and get played out of the speaker.
     * es8311_adc_power_down() sets REG0E[5:4]=11 to power down ADC PGA
     * and modulator, and zeroes REG15 and REG17. */
    ESP_RETURN_ON_ERROR(
        es8311_adc_power_down(s_es8311), TAG, "es8311_adc_power_down");

    /* Set initial output volume */
    ESP_RETURN_ON_ERROR(
        es8311_voice_volume_set(s_es8311, 70, NULL), TAG, "es8311_vol");

    ESP_LOGI(TAG, "ES8311 initialized: %d Hz stereo 16-bit (ADC powered down)",
             CONFIG_SIM_AUDIO_SAMPLE_RATE);
    return ESP_OK;
}

/* ------------------------------------------------------------------ */
/* Public API                                                           */
/* ------------------------------------------------------------------ */

esp_err_t sim_audio_init(void)
{
    ESP_RETURN_ON_FALSE(!s_initialized, ESP_ERR_INVALID_STATE,
                        TAG, "already initialized");

    /* Create I2C master bus */
    i2c_master_bus_config_t i2c_bus_conf = {
        .clk_source = I2C_CLK_SRC_DEFAULT,
        .sda_io_num = CONFIG_SIM_AUDIO_I2C_SDA_GPIO,
        .scl_io_num = CONFIG_SIM_AUDIO_I2C_SCL_GPIO,
        .i2c_port   = CONFIG_SIM_AUDIO_I2C_PORT,
        .flags      = { .enable_internal_pullup = true },
    };
    ESP_RETURN_ON_ERROR(
        i2c_new_master_bus(&i2c_bus_conf, &s_i2c_bus),
        TAG, "i2c_new_master_bus");
    s_bus_owned = true;

    esp_err_t ret = audio_i2s_init();
    if (ret == ESP_OK) ret = audio_codec_init(s_i2c_bus);

    if (ret != ESP_OK) {
        if (s_es8311) { es8311_delete(s_es8311); s_es8311 = NULL; }
        if (s_i2s_tx) { i2s_del_channel(s_i2s_tx); s_i2s_tx = NULL; }
        if (s_bus_owned && s_i2c_bus) {
            i2c_del_master_bus(s_i2c_bus);
            s_i2c_bus   = NULL;
            s_bus_owned = false;
        }
    } else {
        s_initialized = true;
    }
    return ret;
}

esp_err_t sim_audio_init_with_bus(i2c_master_bus_handle_t bus)
{
    ESP_RETURN_ON_FALSE(!s_initialized, ESP_ERR_INVALID_STATE,
                        TAG, "already initialized");
    ESP_RETURN_ON_FALSE(bus != NULL, ESP_ERR_INVALID_ARG,
                        TAG, "bus handle is NULL");

    s_i2c_bus   = bus;
    s_bus_owned = false;

    esp_err_t ret = audio_i2s_init();
    if (ret == ESP_OK) ret = audio_codec_init(bus);

    if (ret != ESP_OK) {
        if (s_es8311) { es8311_delete(s_es8311); s_es8311 = NULL; }
        if (s_i2s_tx) { i2s_del_channel(s_i2s_tx); s_i2s_tx = NULL; }
        s_i2c_bus   = NULL;
        s_bus_owned = false;
    } else {
        s_initialized = true;
    }
    return ret;
}

int sim_audio_write(const int16_t *samples, size_t num_samples, uint32_t timeout_ms)
{
    if (!s_initialized || !samples || num_samples == 0) return -1;

    /* SimCoupe Sound.cpp generates native stereo int16_t (L,R interleaved).
     * num_samples = total samples including both channels (i.e. frames*2).
     * Write directly to I2S — no mono→stereo duplication needed. */
    size_t bytes_to_write = num_samples * sizeof(int16_t);
    size_t bytes_written = 0;
    TickType_t ticks = (timeout_ms == portMAX_DELAY)
                       ? portMAX_DELAY
                       : pdMS_TO_TICKS(timeout_ms);
    esp_err_t err = i2s_channel_write(s_i2s_tx, samples, bytes_to_write,
                                      &bytes_written, ticks);
    if (err != ESP_OK) return -1;
    return (int)(bytes_written / sizeof(int16_t));
}

esp_err_t sim_audio_set_volume(int volume)
{
    if (!s_initialized) return ESP_ERR_INVALID_STATE;
    if (volume < 0)   volume = 0;
    if (volume > 100) volume = 100;
    return es8311_voice_volume_set(s_es8311, volume, NULL);
}

i2s_chan_handle_t sim_audio_get_tx_handle(void)
{
    return s_initialized ? s_i2s_tx : NULL;
}

esp_err_t sim_audio_enable_tx(void)
{
    /* TX is enabled during init (after preload).  This function is kept for
     * API compatibility with callers that call it after the first write. */
    if (!s_initialized || !s_i2s_tx) return ESP_ERR_INVALID_STATE;
    return ESP_OK; /* already enabled */
}

i2c_master_bus_handle_t sim_audio_get_i2c_bus(void)
{
    return s_initialized ? s_i2c_bus : NULL;
}

void sim_audio_deinit(void)
{
    if (!s_initialized) return;

    if (s_es8311) {
        es8311_delete(s_es8311);
        s_es8311 = NULL;
    }

    if (s_i2s_tx) {
        i2s_channel_disable(s_i2s_tx);
        i2s_del_channel(s_i2s_tx);
        s_i2s_tx = NULL;
    }

    if (s_bus_owned && s_i2c_bus) {
        i2c_del_master_bus(s_i2c_bus);
    }
    s_i2c_bus   = NULL;
    s_bus_owned = false;

    s_initialized = false;
    ESP_LOGI(TAG, "sim_audio de-initialized");
}
