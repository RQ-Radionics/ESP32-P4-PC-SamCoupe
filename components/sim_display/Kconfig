## sdkconfig.defaults.olimex-p4pc
```kconfig
# SimCoupe ESP32 — Olimex ESP32-P4-PC target-specific settings
#
# Board: Olimex ESP32-P4-PC
#   Chip:  ESP32-P4NRW32 (dual-core RISC-V 400 MHz, 768 KB RAM, 32 MB PSRAM)
#   Flash: 16 MB SPI
#   WiFi:  none (P4NRW32 has no wireless coprocessor)
#   USB:   USB-JTAG via USB-C (programming + console)
#   SD:    SDMMC slot 0, GPIO 39-44, PWR GPIO 45 (active LOW)
#   Audio: ES8311 codec, I2C1 GPIO7/8, I2S0 GPIO9-13, PA GPIO53
#   HDMI:  LT8912B bridge, MIPI DSI 2-lane, I2C1 GPIO7/8, HPD GPIO15
#   USB HID: FE1.1s hub, HUB_RST# GPIO21, OTG20 HS PHY0

# Chip revision: Olimex uses ESP32-P4NRW32 rev 1.x silicon
CONFIG_ESP32P4_SELECTS_REV_LESS_V3=y
CONFIG_ESP32P4_REV_MIN_1=y
CONFIG_ESP32P4_REV_MIN_FULL=1

# Flash: 16 MB
CONFIG_ESPTOOLPY_FLASHSIZE_16MB=y
CONFIG_ESPTOOLPY_FLASHSIZE="16MB"

# PSRAM: Hex-line 200 MHz (ESP32-P4 16-line interface)
CONFIG_SPIRAM_MODE_HEX=y
CONFIG_SPIRAM_SPEED_200M=y

# Console: USB Serial/JTAG (USB-C connector on the board)
CONFIG_ESP_CONSOLE_USB_SERIAL_JTAG=y
CONFIG_ESP_CONSOLE_SECONDARY_NONE=y

# I2C ISR in IRAM — prevents ESP_ERR_INVALID_STATE when flash cache is busy
CONFIG_I2C_MASTER_ISR_HANDLER_IN_IRAM=y

# USB hub support: FE1.1s 4-port hub between OTG20 HS and keyboard
CONFIG_USB_HOST_HUBS_SUPPORTED=y
CONFIG_USB_HOST_HUB_MULTI_LEVEL=y

# Disable esp-hosted / WiFi coprocessor — this board has no C6 coprocessor
# CONFIG_ESP_HOSTED_ENABLED is not set

# Ethernet: internal EMAC (RMII, IP101GRR PHY)
# Disabled for SimCoupe — no network needed for emulation.
# Enable if you want to add network features later.
# CONFIG_ETH_ENABLED is not set

# -----------------------------------------------------------------------
# SimCoupe hardware component configuration
# -----------------------------------------------------------------------

# sim_display: LT8912B HDMI bridge (MIPI DSI → HDMI)
# I2C1 shared with ES8311 (SDA=GPIO7, SCL=GPIO8)
CONFIG_SIM_DISPLAY_ENABLED=y
CONFIG_SIM_DISPLAY_I2C_PORT=1
CONFIG_SIM_DISPLAY_SDA_GPIO=7
CONFIG_SIM_DISPLAY_SCL_GPIO=8
CONFIG_SIM_DISPLAY_HPD_GPIO=15
CONFIG_SIM_DISPLAY_DSI_LANES=2
CONFIG_SIM_DISPLAY_DSI_LANE_MBPS=896
# 1024×768@60Hz timing (same as esp32-mos, proven working)
CONFIG_SIM_DISPLAY_HACT=1024
CONFIG_SIM_DISPLAY_VACT=768
CONFIG_SIM_DISPLAY_PCLK_MHZ=60
CONFIG_SIM_DISPLAY_HS=83
CONFIG_SIM_DISPLAY_HFP=14
CONFIG_SIM_DISPLAY_HBP=120
CONFIG_SIM_DISPLAY_VS=6
CONFIG_SIM_DISPLAY_VFP=3
CONFIG_SIM_DISPLAY_VBP=29
CONFIG_SIM_DISPLAY_HSYNC_POL=1
CONFIG_SIM_DISPLAY_VSYNC_POL=0
CONFIG_SIM_DISPLAY_SETTLE=0x08
CONFIG_SIM_DISPLAY_DDS_0=0x93
CONFIG_SIM_DISPLAY_DDS_1=0x3E
CONFIG_SIM_DISPLAY_DDS_2=0x29

# sim_audio: ES8311 codec (I2S + I2C)
# I2C1 shared with LT8912B (SDA=GPIO7, SCL=GPIO8)
# I2S1: DOUT=GPIO9, WS=GPIO10, DIN=GPIO11, BCLK=GPIO12, MCLK=GPIO13
# Sample rate: 44100 Hz (SimCoupe SAMPLE_FREQ)
# PA enable: GPIO53 (active HIGH)
CONFIG_SIM_AUDIO_ENABLED=y
CONFIG_SIM_AUDIO_I2C_PORT=1
CONFIG_SIM_AUDIO_I2C_SDA_GPIO=7
CONFIG_SIM_AUDIO_I2C_SCL_GPIO=8
CONFIG_SIM_AUDIO_PWR_GPIO=6
CONFIG_SIM_AUDIO_PA_GPIO=53
CONFIG_SIM_AUDIO_I2S_NUM=1
CONFIG_SIM_AUDIO_I2S_DOUT_GPIO=9
CONFIG_SIM_AUDIO_I2S_WS_GPIO=10
CONFIG_SIM_AUDIO_I2S_DIN_GPIO=11
CONFIG_SIM_AUDIO_I2S_BCLK_GPIO=12
CONFIG_SIM_AUDIO_I2S_MCLK_GPIO=13
CONFIG_SIM_AUDIO_SAMPLE_RATE=44100

# sim_kbd: USB HID keyboard via IDF usb_host
# OTG20 HS PHY0, FE1.1s hub reset on GPIO21
CONFIG_SIM_KBD_ENABLED=y
CONFIG_SIM_KBD_HUB_RST_GPIO=21
CONFIG_SIM_KBD_USB_DP_GPIO=27
CONFIG_SIM_KBD_USB_DM_GPIO=26

# sim_sdcard: SDMMC slot 0
# GPIO 39-44 (CLK, CMD, D0-D3), PWR GPIO45 (active LOW)
CONFIG_SIM_SDCARD_ENABLED=y
CONFIG_SIM_SDCARD_CLK_GPIO=39
CONFIG_SIM_SDCARD_CMD_GPIO=40
CONFIG_SIM_SDCARD_D0_GPIO=41
CONFIG_SIM_SDCARD_D1_GPIO=42
CONFIG_SIM_SDCARD_D2_GPIO=43
CONFIG_SIM_SDCARD_D3_GPIO=44
CONFIG_SIM_SDCARD_PWR_GPIO=45
```
