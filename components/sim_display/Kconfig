## components/sim_display/Kconfig
```kconfig
menu "SimCoupe Display (LT8912B HDMI Bridge)"
    depends on IDF_TARGET_ESP32P4

    config SIM_DISPLAY_ENABLED
        bool "Enable LT8912B HDMI bridge driver"
        default n
        help
            Enable the LT8912B MIPI DSI to HDMI bridge driver for SimCoupe.
            Required for HDMI output on boards with an LT8912B chip
            (e.g. Olimex ESP32-P4-PC).

    if SIM_DISPLAY_ENABLED

    config SIM_DISPLAY_I2C_PORT
        int "I2C port number"
        default 1
        range 0 1
        help
            I2C port used to configure the LT8912B (sub-addresses 0x48/0x49/0x4A)
            and ES8311 audio codec (0x18). Both share this bus.

    config SIM_DISPLAY_SDA_GPIO
        int "I2C SDA GPIO"
        default 7
        help
            GPIO for I2C SDA. Olimex ESP32-P4-PC: GPIO7.

    config SIM_DISPLAY_SCL_GPIO
        int "I2C SCL GPIO"
        default 8
        help
            GPIO for I2C SCL. Olimex ESP32-P4-PC: GPIO8.

    config SIM_DISPLAY_HPD_GPIO
        int "HDMI Hot-Plug Detect GPIO (-1 = disabled)"
        default 15
        range -1 56
        help
            GPIO for HDMI hot-plug detect. Olimex ESP32-P4-PC: GPIO15.

    config SIM_DISPLAY_HDMI_MODE
        bool "HDMI mode (vs DVI)"
        default y
        help
            Enable HDMI mode (with audio info frame). Disable for DVI-only monitors.

    config SIM_DISPLAY_DSI_LANES
        int "DSI lane count"
        default 2
        range 1 2
        help
            Number of MIPI DSI data lanes.

    config SIM_DISPLAY_DSI_LANE_MBPS
        int "DSI lane bit rate (Mbps)"
        default 896
        help
            MIPI DSI bit rate per lane in Mbps.
            Must satisfy: lane_mbps >= pclk_mhz * 24 / num_lanes (with margin).
            1024x768@60MHz/2lanes: 60*24/2=720 Mbps → 896 Mbps matches production test.

    # ---------------------------------------------------------------
    # Video timing — single source of truth for all timing parameters.
    # ---------------------------------------------------------------

    config SIM_DISPLAY_HACT
        int "Horizontal active pixels"
        default 1024
        help
            Horizontal active pixel count (e.g. 1024 for 1024x768).

    config SIM_DISPLAY_VACT
        int "Vertical active lines"
        default 768
        help
            Vertical active line count (e.g. 768 for 1024x768).

    config SIM_DISPLAY_PCLK_MHZ
        int "Pixel clock (MHz)"
        default 60
        help
            Pixel clock in MHz. Passed to esp_lcd_new_panel_dpi() as
            dpi_clock_freq_mhz. For 1024x768@60Hz (Olimex production test
            timings), use 60 MHz with MIPI_DSI_DPI_CLK_SRC_DEFAULT.

    config SIM_DISPLAY_HS
        int "Horizontal sync width (pixels)"
        default 8
        help
            Horizontal sync pulse width in pixels.
            1024x768@60Hz: hs=8, htotal=1024+8+48+140=1220.

    config SIM_DISPLAY_HFP
        int "Horizontal front porch (pixels)"
        default 48
        help
            Horizontal front porch in pixels.

    config SIM_DISPLAY_HBP
        int "Horizontal back porch (pixels)"
        default 140
        help
            Horizontal back porch in pixels.

    config SIM_DISPLAY_VS
        int "Vertical sync width (lines)"
        default 6
        help
            Vertical sync pulse width in lines.

    config SIM_DISPLAY_VFP
        int "Vertical front porch (lines)"
        default 3
        help
            Vertical front porch in lines.

    config SIM_DISPLAY_VBP
        int "Vertical back porch (lines)"
        default 42
        help
            Vertical back porch in lines.
            1024x768@60Hz: vbp=42, vtotal=768+6+3+42=819.

    config SIM_DISPLAY_HSYNC_POL
        int "Horizontal sync polarity (1=positive, 0=negative)"
        default 1
        range 0 1

    config SIM_DISPLAY_VSYNC_POL
        int "Vertical sync polarity (1=positive, 0=negative)"
        default 1
        range 0 1

    config SIM_DISPLAY_VIC
        int "CEA-861 Video Identification Code (VIC)"
        default 4
        help
            VIC for the AVI InfoFrame. Standard values:
            0  = no specific mode (use for non-CEA modes like 1024x768)
            4  = 1280x720@60Hz (720p)
            16 = 1920x1080@60Hz (1080p)
            2  = 720x480@60Hz (480p 4:3)

    config SIM_DISPLAY_SETTLE
        hex "MIPI DSI settle register (0x49:0x11)"
        default 0x0A
        help
            MIPI DSI settle time register value.
            Linux kernel rule: 0x04 for vactive<=600, 0x08 for <=900, 0x0a for >900.
            Use 0x0A for 720p/1080p.

    config SIM_DISPLAY_DDS_0
        hex "DDS frequency word byte 0 (LSB, reg 0x4E)"
        default 0xAC
        help
            strm_sw_freq_word[7:0]. Formula: pclk_mhz * 0x16C16.
            720p@74MHz: 74 * 0x16C16 = 0x6D28AC → byte0=0xAC.

    config SIM_DISPLAY_DDS_1
        hex "DDS frequency word byte 1 (reg 0x4F)"
        default 0x28
        help
            strm_sw_freq_word[15:8]. 720p@74MHz → byte1=0x28.

    config SIM_DISPLAY_DDS_2
        hex "DDS frequency word byte 2 (MSB, reg 0x50)"
        default 0x6D
        help
            strm_sw_freq_word[23:16]. 720p@74MHz → byte2=0x6D.

    config SIM_DISPLAY_HDMI_MODE
        int "HDMI output mode (1=HDMI, 0=DVI)"
        default 0
        range 0 1
        help
            LT8912B reg 0xB2: 1=HDMI mode, 0=DVI mode.
            Some PC monitors (HP, Dell) require DVI mode (0) to accept signal.
            TVs and most modern monitors work with HDMI mode (1).

    endif # SIM_DISPLAY_ENABLED

endmenu
```

## sdkconfig.defaults
```kconfig
# SimCoupe — Olimex ESP32-P4-PC SDK configuration
# Single file: this project targets only the Olimex ESP32-P4-PC board.

# ── DW-GDMA: ISR + objects in IRAM/DRAM ──────────────────────────────────
# The DW-GDMA ISR fires during esp_cache_msync() (display flush).
# Without IRAM-safe ISR + DRAM-safe objects, the ISR reads the channel
# object from PSRAM while the cache is being flushed → Load access fault
# (dev=0x0 in dw_gdma_channel_default_isr, MTVAL=0x188).
#
# DW_GDMA_ISR_IRAM_SAFE and DW_GDMA_OBJ_DRAM_SAFE are hidden Kconfig symbols
# (no "prompt", cannot be set directly from sdkconfig.defaults).
# The correct path is via the visible LCD DSI symbol:
#   LCD_DSI_ISR_CACHE_SAFE → selects DW_GDMA_ISR_IRAM_SAFE
#                           → selects DW_GDMA_OBJ_DRAM_SAFE
# This puts the DW-GDMA channel/group objects in DRAM and the ISR in IRAM.
CONFIG_LCD_DSI_ISR_CACHE_SAFE=y

# ── Partition table ────────────────────────────────────────────────────────
CONFIG_PARTITION_TABLE_CUSTOM=y
CONFIG_PARTITION_TABLE_CUSTOM_FILENAME="partitions.csv"

# ── Chip: Olimex ESP32-P4-PC — silicon rev 1.x (hw_ver1) ─────────────────
# ESP32P4_SELECTS_REV_LESS_V3=y unlocks the rev-0/1 choices in the
# ESP32P4_REV_MIN choice (they depend on this symbol).
# ESP32P4_REV_MIN_100 = "Rev v1.0" (FULL=100) — correct for rev-1.x silicon.
# Without SELECTS_REV_LESS_V3, IDF defaults to rev-3.x and selects hw_ver3
# headers, causing "missing hp_sys_clkrst_struct.h" on rev-1 hardware.
CONFIG_ESP32P4_SELECTS_REV_LESS_V3=y
CONFIG_ESP32P4_REV_MIN_100=y
CONFIG_ESP32P4_REV_MIN_FULL=100

# ── Flash: 16 MB ──────────────────────────────────────────────────────────
CONFIG_ESPTOOLPY_FLASHSIZE_16MB=y
CONFIG_ESPTOOLPY_FLASHSIZE="16MB"

# ── PSRAM: Hex-line 200 MHz ────────────────────────────────────────────────
CONFIG_SPIRAM=y
CONFIG_SPIRAM_MODE_HEX=y
CONFIG_SPIRAM_SPEED_200M=y
# Allow global BSS to be placed in PSRAM via ldgen extram_bss mapping
CONFIG_SPIRAM_ALLOW_BSS_SEG_EXTERNAL_MEMORY=y
# Allow FreeRTOS tasks to be created with stacks in PSRAM
CONFIG_FREERTOS_TASK_CREATE_ALLOW_EXT_MEM=y
# Allocations <= 64KB go to internal SRAM; larger ones go to PSRAM
# Increased from 16KB to ensure filesystem locks, semaphores, and other
# small kernel objects stay in DRAM (not PSRAM) to avoid cache coherency issues
CONFIG_SPIRAM_MALLOC_ALWAYSINTERNAL=65536

# ── Console: USB Serial/JTAG (USB-C on the board) ─────────────────────────
CONFIG_ESP_CONSOLE_USB_SERIAL_JTAG=y
CONFIG_ESP_CONSOLE_SECONDARY_NONE=y

# ── FreeRTOS ───────────────────────────────────────────────────────────────
CONFIG_FREERTOS_HZ=1000

# ── Stack sizes ────────────────────────────────────────────────────────────
# app_main only does NVS init + spawns simcoupe_task
CONFIG_ESP_MAIN_TASK_STACK_SIZE=8192
# sys_evt task needs extra room with PSRAM/logging overhead
CONFIG_ESP_SYSTEM_EVENT_TASK_STACK_SIZE=4096

# ── CPU frequency ─────────────────────────────────────────────────────────
# Match Olimex production BSP: 360MHz (not the IDF default which may be lower)
CONFIG_ESP_DEFAULT_CPU_FREQ_MHZ_360=y
CONFIG_ESP_DEFAULT_CPU_FREQ_MHZ=360

# ── Compiler optimisation ─────────────────────────────────────────────────
# Use -O2 globally (performance mode). The default DEBUG mode uses -Og which
# is far too slow for Z80 emulation. simcoupe_core also sets -O2 explicitly
# in its CMakeLists.txt to ensure it is never accidentally compiled at -Og.
CONFIG_COMPILER_OPTIMIZATION_PERF=y

# ── Logging ────────────────────────────────────────────────────────────────
CONFIG_LOG_DEFAULT_LEVEL_INFO=y
CONFIG_LOG_DEFAULT_LEVEL=3

# ── Task watchdog ──────────────────────────────────────────────────────────
# The emulation loop legitimately saturates CPUs; IDLE starvation WDT
# fires spuriously and causes DMA crashes.
CONFIG_ESP_TASK_WDT_CHECK_IDLE_TASK_CPU0=n
CONFIG_ESP_TASK_WDT_CHECK_IDLE_TASK_CPU1=n

# ── FAT filesystem + Wear Levelling ───────────────────────────────────────
CONFIG_FATFS_SECTOR_512=y
CONFIG_FATFS_LFN_HEAP=y
CONFIG_FATFS_MAX_LFN=255
CONFIG_WL_SECTOR_SIZE_512=y
CONFIG_WL_SECTOR_MODE_PERF=y

# ── USB host (keyboard via USB HID) ───────────────────────────────────────
CONFIG_USB_HOST_HUBS_SUPPORTED=y
CONFIG_USB_HOST_HUB_MULTI_LEVEL=y

# ── I2S ISR + GDMA objects in IRAM/DRAM ──────────────────────────────────
# The I2S DMA TX callback (i2s_dma_tx_callback) fires from the AHB-GDMA ISR.
# The I2S channel object (including msg_queue) is allocated in PSRAM by default.
# When esp_cache_msync() flushes PSRAM, the ISR reads msg_queue=NULL → assert.
# CONFIG_I2S_ISR_IRAM_SAFE=y selects GDMA_ISR_HANDLER_IN_IRAM → GDMA_OBJ_DRAM_SAFE,
# putting the AHB-GDMA channel objects in DRAM and the ISR in IRAM.
CONFIG_I2S_ISR_IRAM_SAFE=y

# ── I2C ISR in IRAM ───────────────────────────────────────────────────────
# Prevents ESP_ERR_INVALID_STATE when flash cache is busy during I2C transfers
CONFIG_I2C_MASTER_ISR_HANDLER_IN_IRAM=y

# ── esp-hosted / WiFi coprocessor: not present on this board ──────────────
# CONFIG_ESP_HOSTED_ENABLED is not set

# ── ES8311 audio codec (I2S + I2C) ────────────────────────────────────────
# I2C1 SDA=GPIO7 SCL=GPIO8, I2S1 GPIO9-13, PWR=GPIO6, PA=GPIO53
CONFIG_SIM_AUDIO_ENABLED=y
CONFIG_SIM_AUDIO_I2C_PORT=1
CONFIG_SIM_AUDIO_I2C_SDA_GPIO=7
CONFIG_SIM_AUDIO_I2C_SCL_GPIO=8
CONFIG_SIM_AUDIO_PWR_GPIO=6
CONFIG_SIM_AUDIO_PA_GPIO=53
CONFIG_SIM_AUDIO_I2S_NUM=1
CONFIG_SIM_AUDIO_I2S_DOUT_GPIO=9
CONFIG_SIM_AUDIO_I2S_WS_GPIO=10
CONFIG_SIM_AUDIO_I2S_DIN_GPIO=11
CONFIG_SIM_AUDIO_I2S_BCLK_GPIO=12
CONFIG_SIM_AUDIO_I2S_MCLK_GPIO=13
CONFIG_SIM_AUDIO_SAMPLE_RATE=22050

# ── USB HID keyboard ───────────────────────────────────────────────────────
# FE1.1s hub RST=GPIO21, OTG20 HS D+=GPIO27 D-=GPIO26
CONFIG_SIM_KBD_ENABLED=y
CONFIG_SIM_KBD_HUB_RST_GPIO=21
CONFIG_SIM_KBD_USB_DP_GPIO=27
CONFIG_SIM_KBD_USB_DM_GPIO=26

# ── SD card (SDMMC 4-bit, Slot 0) ─────────────────────────────────────────
# CLK=GPIO43 CMD=GPIO44 D0=GPIO39 D1=GPIO40 D2=GPIO41 D3=GPIO42
# LDO_VO4 enabled in code (sd_pwr_ctrl_new_on_chip_ldo, chan 4)
# GPIO pins are hard-coded in sim_sdcard.c — no Kconfig symbols needed.
CONFIG_SIM_SDCARD_ENABLED=y

# ── LT8912B HDMI bridge (MIPI DSI → HDMI) ─────────────────────────────────
# I2C1 SDA=GPIO7 SCL=GPIO8 (shared with ES8311 audio codec)
CONFIG_SIM_DISPLAY_ENABLED=y
CONFIG_SIM_DISPLAY_I2C_PORT=1
CONFIG_SIM_DISPLAY_SDA_GPIO=7
CONFIG_SIM_DISPLAY_SCL_GPIO=8
CONFIG_SIM_DISPLAY_HPD_GPIO=15
CONFIG_SIM_DISPLAY_HDMI_MODE=y
CONFIG_SIM_DISPLAY_DSI_LANES=2
CONFIG_SIM_DISPLAY_DSI_LANE_MBPS=1000
# 1920×1080@60Hz via LT8912B (MIPI DSI → HDMI).
#
# pclk=64MHz matches the Olimex factory firmware.
# PLL_F240M/4 = 60MHz actual hardware DPI clock (closest achievable).
# IDF uses expect=64MHz for host lane-clock ratio → host_hact=3750 lane-clocks ✓
# (same as factory firmware with IDF 5.5.1).
#
# IDF 5.5.3 added brg_comp = round(real/expect × htotal) - htotal which gives
# brg_comp=-130 with real=60/expect=64 → bridge htotal=1950 (broken).
# Fix: patched /components/hal/mipi_dsi_hal.c to remove the compensation
# (restores IDF 5.5.1 behaviour: bridge gets raw pixel-clock timings, no comp).
#
# Lane rate: 1000Mbps/lane × 2 lanes = 2000Mbps total.
# SAM 512×192 scaled 3×H 5×V → 1536×960, centred in 1920×1080. OFF_X=192, OFF_Y=60.
# Framebuffer: 1920×1080×3 = 6.22MB in PSRAM.
CONFIG_SIM_DISPLAY_HACT=1920
CONFIG_SIM_DISPLAY_VACT=1080
CONFIG_SIM_DISPLAY_PCLK_MHZ=64
CONFIG_SIM_DISPLAY_HS=32
CONFIG_SIM_DISPLAY_HFP=48
CONFIG_SIM_DISPLAY_HBP=80
CONFIG_SIM_DISPLAY_VS=5
CONFIG_SIM_DISPLAY_VFP=3
CONFIG_SIM_DISPLAY_VBP=19
CONFIG_SIM_DISPLAY_HSYNC_POL=1
CONFIG_SIM_DISPLAY_VSYNC_POL=0
CONFIG_SIM_DISPLAY_SETTLE=0x08
CONFIG_SIM_DISPLAY_DDS_0=0x93
CONFIG_SIM_DISPLAY_DDS_1=0x3E
CONFIG_SIM_DISPLAY_DDS_2=0x29
```
